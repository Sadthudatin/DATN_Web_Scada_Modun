## firmware/main/Kconfig.projbuild
```kconfig
menu "IoT Gateway"

config GW_WIFI_SSID
    string "Wi-Fi SSID (empty = use W5500 Ethernet)"
    default ""

config GW_WIFI_PASSWORD
    string "Wi-Fi password"
    default ""

config GW_GATEWAY_ID
    string "Gateway ID used in MQTT topics"
    default "GW_001"

config GW_PLC_ID
    string "PLC ID reported in telemetry"
    default "PLC_001"

config GW_MQTT_URI
    string "MQTT broker URI"
    default "mqtt://192.168.1.100:1883"

config GW_MQTT_USERNAME
    string "MQTT username"
    default ""

config GW_MQTT_PASSWORD
    string "MQTT password"
    default ""

endmenu
```

## firmware/sdkconfig.defaults
```kconfig
CONFIG_IDF_TARGET="esp32s3"
CONFIG_ESPTOOLPY_FLASHSIZE_8MB=y
CONFIG_PARTITION_TABLE_CUSTOM=y
CONFIG_PARTITION_TABLE_CUSTOM_FILENAME="partitions.csv"

# CPU / RTOS
CONFIG_ESP_DEFAULT_CPU_FREQ_MHZ_240=y
CONFIG_FREERTOS_HZ=1000
CONFIG_ESP_TASK_WDT_TIMEOUT_S=15
CONFIG_ESP_MAIN_TASK_STACK_SIZE=8192

# PSRAM (N8R2 = quad SPI PSRAM)
CONFIG_SPIRAM=y
CONFIG_SPIRAM_MODE_QUAD=y
CONFIG_SPIRAM_SPEED_80M=y
CONFIG_SPIRAM_USE_MALLOC=y

# MQTT
CONFIG_MQTT_PROTOCOL_311=y
CONFIG_MQTT_TRANSPORT_SSL=y
CONFIG_MQTT_TRANSPORT_WEBSOCKET=y

# FATFS (store-and-forward journal)
CONFIG_FATFS_LFN_HEAP=y
CONFIG_FATFS_MAX_LFN=255
CONFIG_FATFS_ALLOC_PREFER_EXTRAM=y

# lwIP
CONFIG_LWIP_MAX_SOCKETS=10
CONFIG_LWIP_SO_RCVBUF=y
```
